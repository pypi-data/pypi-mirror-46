	std::make_pair(std::make_pair(Mode::UPPER, 0x20), FixLenInteger(5, 1)),
	std::make_pair(std::make_pair(Mode::UPPER, 0x41), FixLenInteger(5, 2)),
	std::make_pair(std::make_pair(Mode::UPPER, 0x42), FixLenInteger(5, 3)),
	std::make_pair(std::make_pair(Mode::UPPER, 0x43), FixLenInteger(5, 4)),
	std::make_pair(std::make_pair(Mode::UPPER, 0x44), FixLenInteger(5, 5)),
	std::make_pair(std::make_pair(Mode::UPPER, 0x45), FixLenInteger(5, 6)),
	std::make_pair(std::make_pair(Mode::UPPER, 0x46), FixLenInteger(5, 7)),
	std::make_pair(std::make_pair(Mode::UPPER, 0x47), FixLenInteger(5, 8)),
	std::make_pair(std::make_pair(Mode::UPPER, 0x48), FixLenInteger(5, 9)),
	std::make_pair(std::make_pair(Mode::UPPER, 0x49), FixLenInteger(5, 10)),
	std::make_pair(std::make_pair(Mode::UPPER, 0x4a), FixLenInteger(5, 11)),
	std::make_pair(std::make_pair(Mode::UPPER, 0x4b), FixLenInteger(5, 12)),
	std::make_pair(std::make_pair(Mode::UPPER, 0x4c), FixLenInteger(5, 13)),
	std::make_pair(std::make_pair(Mode::UPPER, 0x4d), FixLenInteger(5, 14)),
	std::make_pair(std::make_pair(Mode::UPPER, 0x4e), FixLenInteger(5, 15)),
	std::make_pair(std::make_pair(Mode::UPPER, 0x4f), FixLenInteger(5, 16)),
	std::make_pair(std::make_pair(Mode::UPPER, 0x50), FixLenInteger(5, 17)),
	std::make_pair(std::make_pair(Mode::UPPER, 0x51), FixLenInteger(5, 18)),
	std::make_pair(std::make_pair(Mode::UPPER, 0x52), FixLenInteger(5, 19)),
	std::make_pair(std::make_pair(Mode::UPPER, 0x53), FixLenInteger(5, 20)),
	std::make_pair(std::make_pair(Mode::UPPER, 0x54), FixLenInteger(5, 21)),
	std::make_pair(std::make_pair(Mode::UPPER, 0x55), FixLenInteger(5, 22)),
	std::make_pair(std::make_pair(Mode::UPPER, 0x56), FixLenInteger(5, 23)),
	std::make_pair(std::make_pair(Mode::UPPER, 0x57), FixLenInteger(5, 24)),
	std::make_pair(std::make_pair(Mode::UPPER, 0x58), FixLenInteger(5, 25)),
	std::make_pair(std::make_pair(Mode::UPPER, 0x59), FixLenInteger(5, 26)),
	std::make_pair(std::make_pair(Mode::UPPER, 0x5a), FixLenInteger(5, 27)),
	std::make_pair(std::make_pair(Mode::LOWER, 0x20), FixLenInteger(5, 1)),
	std::make_pair(std::make_pair(Mode::LOWER, 0x61), FixLenInteger(5, 2)),
	std::make_pair(std::make_pair(Mode::LOWER, 0x62), FixLenInteger(5, 3)),
	std::make_pair(std::make_pair(Mode::LOWER, 0x63), FixLenInteger(5, 4)),
	std::make_pair(std::make_pair(Mode::LOWER, 0x64), FixLenInteger(5, 5)),
	std::make_pair(std::make_pair(Mode::LOWER, 0x65), FixLenInteger(5, 6)),
	std::make_pair(std::make_pair(Mode::LOWER, 0x66), FixLenInteger(5, 7)),
	std::make_pair(std::make_pair(Mode::LOWER, 0x67), FixLenInteger(5, 8)),
	std::make_pair(std::make_pair(Mode::LOWER, 0x68), FixLenInteger(5, 9)),
	std::make_pair(std::make_pair(Mode::LOWER, 0x69), FixLenInteger(5, 10)),
	std::make_pair(std::make_pair(Mode::LOWER, 0x6a), FixLenInteger(5, 11)),
	std::make_pair(std::make_pair(Mode::LOWER, 0x6b), FixLenInteger(5, 12)),
	std::make_pair(std::make_pair(Mode::LOWER, 0x6c), FixLenInteger(5, 13)),
	std::make_pair(std::make_pair(Mode::LOWER, 0x6d), FixLenInteger(5, 14)),
	std::make_pair(std::make_pair(Mode::LOWER, 0x6e), FixLenInteger(5, 15)),
	std::make_pair(std::make_pair(Mode::LOWER, 0x6f), FixLenInteger(5, 16)),
	std::make_pair(std::make_pair(Mode::LOWER, 0x70), FixLenInteger(5, 17)),
	std::make_pair(std::make_pair(Mode::LOWER, 0x71), FixLenInteger(5, 18)),
	std::make_pair(std::make_pair(Mode::LOWER, 0x72), FixLenInteger(5, 19)),
	std::make_pair(std::make_pair(Mode::LOWER, 0x73), FixLenInteger(5, 20)),
	std::make_pair(std::make_pair(Mode::LOWER, 0x74), FixLenInteger(5, 21)),
	std::make_pair(std::make_pair(Mode::LOWER, 0x75), FixLenInteger(5, 22)),
	std::make_pair(std::make_pair(Mode::LOWER, 0x76), FixLenInteger(5, 23)),
	std::make_pair(std::make_pair(Mode::LOWER, 0x77), FixLenInteger(5, 24)),
	std::make_pair(std::make_pair(Mode::LOWER, 0x78), FixLenInteger(5, 25)),
	std::make_pair(std::make_pair(Mode::LOWER, 0x79), FixLenInteger(5, 26)),
	std::make_pair(std::make_pair(Mode::LOWER, 0x7a), FixLenInteger(5, 27)),
	std::make_pair(std::make_pair(Mode::DIGIT, 0x20), FixLenInteger(4, 1)),
	std::make_pair(std::make_pair(Mode::DIGIT, 0x30), FixLenInteger(4, 2)),
	std::make_pair(std::make_pair(Mode::DIGIT, 0x31), FixLenInteger(4, 3)),
	std::make_pair(std::make_pair(Mode::DIGIT, 0x32), FixLenInteger(4, 4)),
	std::make_pair(std::make_pair(Mode::DIGIT, 0x33), FixLenInteger(4, 5)),
	std::make_pair(std::make_pair(Mode::DIGIT, 0x34), FixLenInteger(4, 6)),
	std::make_pair(std::make_pair(Mode::DIGIT, 0x35), FixLenInteger(4, 7)),
	std::make_pair(std::make_pair(Mode::DIGIT, 0x36), FixLenInteger(4, 8)),
	std::make_pair(std::make_pair(Mode::DIGIT, 0x37), FixLenInteger(4, 9)),
	std::make_pair(std::make_pair(Mode::DIGIT, 0x38), FixLenInteger(4, 10)),
	std::make_pair(std::make_pair(Mode::DIGIT, 0x39), FixLenInteger(4, 11)),
	std::make_pair(std::make_pair(Mode::DIGIT, 0x2c), FixLenInteger(4, 12)),
	std::make_pair(std::make_pair(Mode::DIGIT, 0x2e), FixLenInteger(4, 13)),
	std::make_pair(std::make_pair(Mode::PUNCT, 0x0d), FixLenInteger(5, 1)),
	std::make_pair(std::make_pair(Mode::PUNCT, 0x21), FixLenInteger(5, 6)),
	std::make_pair(std::make_pair(Mode::PUNCT, 0x22), FixLenInteger(5, 7)),
	std::make_pair(std::make_pair(Mode::PUNCT, 0x23), FixLenInteger(5, 8)),
	std::make_pair(std::make_pair(Mode::PUNCT, 0x24), FixLenInteger(5, 9)),
	std::make_pair(std::make_pair(Mode::PUNCT, 0x25), FixLenInteger(5, 10)),
	std::make_pair(std::make_pair(Mode::PUNCT, 0x26), FixLenInteger(5, 11)),
	std::make_pair(std::make_pair(Mode::PUNCT, 0x27), FixLenInteger(5, 12)),
	std::make_pair(std::make_pair(Mode::PUNCT, 0x28), FixLenInteger(5, 13)),
	std::make_pair(std::make_pair(Mode::PUNCT, 0x29), FixLenInteger(5, 14)),
	std::make_pair(std::make_pair(Mode::PUNCT, 0x2a), FixLenInteger(5, 15)),
	std::make_pair(std::make_pair(Mode::PUNCT, 0x2b), FixLenInteger(5, 16)),
	std::make_pair(std::make_pair(Mode::PUNCT, 0x2c), FixLenInteger(5, 17)),
	std::make_pair(std::make_pair(Mode::PUNCT, 0x2d), FixLenInteger(5, 18)),
	std::make_pair(std::make_pair(Mode::PUNCT, 0x2e), FixLenInteger(5, 19)),
	std::make_pair(std::make_pair(Mode::PUNCT, 0x2f), FixLenInteger(5, 20)),
	std::make_pair(std::make_pair(Mode::PUNCT, 0x3a), FixLenInteger(5, 21)),
	std::make_pair(std::make_pair(Mode::PUNCT, 0x3b), FixLenInteger(5, 22)),
	std::make_pair(std::make_pair(Mode::PUNCT, 0x3c), FixLenInteger(5, 23)),
	std::make_pair(std::make_pair(Mode::PUNCT, 0x3d), FixLenInteger(5, 24)),
	std::make_pair(std::make_pair(Mode::PUNCT, 0x3e), FixLenInteger(5, 25)),
	std::make_pair(std::make_pair(Mode::PUNCT, 0x3f), FixLenInteger(5, 26)),
	std::make_pair(std::make_pair(Mode::PUNCT, 0x5b), FixLenInteger(5, 27)),
	std::make_pair(std::make_pair(Mode::PUNCT, 0x5d), FixLenInteger(5, 28)),
	std::make_pair(std::make_pair(Mode::PUNCT, 0x7b), FixLenInteger(5, 29)),
	std::make_pair(std::make_pair(Mode::PUNCT, 0x7d), FixLenInteger(5, 30)),
	std::make_pair(std::make_pair(Mode::MIXED, 0x20), FixLenInteger(5, 1)),
	std::make_pair(std::make_pair(Mode::MIXED, 0x01), FixLenInteger(5, 2)),
	std::make_pair(std::make_pair(Mode::MIXED, 0x02), FixLenInteger(5, 3)),
	std::make_pair(std::make_pair(Mode::MIXED, 0x03), FixLenInteger(5, 4)),
	std::make_pair(std::make_pair(Mode::MIXED, 0x04), FixLenInteger(5, 5)),
	std::make_pair(std::make_pair(Mode::MIXED, 0x05), FixLenInteger(5, 6)),
	std::make_pair(std::make_pair(Mode::MIXED, 0x06), FixLenInteger(5, 7)),
	std::make_pair(std::make_pair(Mode::MIXED, 0x07), FixLenInteger(5, 8)),
	std::make_pair(std::make_pair(Mode::MIXED, 0x08), FixLenInteger(5, 9)),
	std::make_pair(std::make_pair(Mode::MIXED, 0x09), FixLenInteger(5, 10)),
	std::make_pair(std::make_pair(Mode::MIXED, 0x0a), FixLenInteger(5, 11)),
	std::make_pair(std::make_pair(Mode::MIXED, 0x0b), FixLenInteger(5, 12)),
	std::make_pair(std::make_pair(Mode::MIXED, 0x0c), FixLenInteger(5, 13)),
	std::make_pair(std::make_pair(Mode::MIXED, 0x0d), FixLenInteger(5, 14)),
	std::make_pair(std::make_pair(Mode::MIXED, 0x1b), FixLenInteger(5, 15)),
	std::make_pair(std::make_pair(Mode::MIXED, 0x1c), FixLenInteger(5, 16)),
	std::make_pair(std::make_pair(Mode::MIXED, 0x1d), FixLenInteger(5, 17)),
	std::make_pair(std::make_pair(Mode::MIXED, 0x1e), FixLenInteger(5, 18)),
	std::make_pair(std::make_pair(Mode::MIXED, 0x1f), FixLenInteger(5, 19)),
	std::make_pair(std::make_pair(Mode::MIXED, 0x40), FixLenInteger(5, 20)),
	std::make_pair(std::make_pair(Mode::MIXED, 0x5c), FixLenInteger(5, 21)),
	std::make_pair(std::make_pair(Mode::MIXED, 0x5e), FixLenInteger(5, 22)),
	std::make_pair(std::make_pair(Mode::MIXED, 0x5f), FixLenInteger(5, 23)),
	std::make_pair(std::make_pair(Mode::MIXED, 0x60), FixLenInteger(5, 24)),
	std::make_pair(std::make_pair(Mode::MIXED, 0x7c), FixLenInteger(5, 25)),
	std::make_pair(std::make_pair(Mode::MIXED, 0x7e), FixLenInteger(5, 26)),
	std::make_pair(std::make_pair(Mode::MIXED, 0x7f), FixLenInteger(5, 27))
